/*
 * Copyright (c) 2024 Pete Johanson
 *
 * SPDX-License-Identifier: MIT
 */

#include "calvin_toprevan.dtsi"

&matrix {
    strobe-input-masks = <0 0 0 (BIT(2) + BIT(3) + BIT(4) + BIT(6) + BIT(7) + BIT(8) + BIT(9))>;
};

&eight_half_bar_transform { status = "okay"; };
&eight_half_bar_physical_layout { status = "okay"; };
