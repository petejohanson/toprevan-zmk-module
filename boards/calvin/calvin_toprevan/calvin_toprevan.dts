/*
 * Copyright (c) 2024 Pete Johanson
 *
 * SPDX-License-Identifier: MIT
 */

#include "calvin_toprevan.dtsi"

&matrix {
    strobe-input-masks = <0 0 0 (BIT(3) + BIT(5) + BIT(7))>;
};

&transform { status = "okay"; };
&physical_layout { status = "okay"; };
