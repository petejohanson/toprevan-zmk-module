/*
 * Copyright (c) 2024 Pete Johanson
 *
 * SPDX-License-Identifier: MIT
 */

#include "calvin_toprevan.dtsi"

&matrix { status = "okay"; };
&transform { status = "okay"; };
&physical_layout { status = "okay"; };
