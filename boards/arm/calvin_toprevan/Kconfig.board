## boards/arm/calvin_toprevan/Kconfig.board
```kconfig
# Copyright (c) 2024 Pete Johanson
# SPDX-License-Identifier: MIT

config BOARD_CALVIN_TOPREVAN
	bool "Calvin TopreVan"
	depends on SOC_STM32F401XC
	select ADC

config BOARD_CALVIN_TOPREVAN_BIG_BAR
	bool "Calvin TopreVan"
	depends on SOC_STM32F401XC
	select ADC
```

## boards/arm/calvin_toprevan/Kconfig.defconfig
```kconfig
# Copyright (c) 2022 Linaro Limited
# SPDX-License-Identifier: Apache-2.0

# F401CE based Black Pill V3.0+ board board configuration

if BOARD_CALVIN_TOPREVAN

config BOARD
	default "calvin_toprevan"

config ZMK_KEYBOARD_NAME
        default "TopreVan"

config ZMK_KSCAN_EC_MATRIX_SETTINGS_DISCRETE
	default y

config SPI_STM32_INTERRUPT
	default y
	depends on SPI

config BUILD_OUTPUT_UF2_USE_FLASH_BASE
	default y

config BUILD_OUTPUT_UF2_USE_FLASH_OFFSET
	default y

endif # BOARD_CALVIN_TOPREVAN
```

## boards/arm/calvin_toprevan/calvin_toprevan_big_bar_defconfig
```kconfig
# Copyright (c) 2024 Pete Johanson
# SPDX-License-Identifier: MIT

CONFIG_BOARD_CALVIN_TOPREVAN_BIG_BAR=y
CONFIG_SOC_SERIES_STM32F4X=y
CONFIG_SOC_STM32F401XC=y

# Enable MPU
# CONFIG_ARM_MPU=y

# Enable HW stack protection
CONFIG_HW_STACK_PROTECTION=y

# Enable GPIO
CONFIG_GPIO=y

# Clock configuration
CONFIG_CLOCK_CONTROL=y

# enable pin controller
CONFIG_PINCTRL=y

# ZMK Settings
CONFIG_ZMK_USB=y

# Settings subsystem
CONFIG_SETTINGS=y
CONFIG_FLASH=y
CONFIG_FLASH_MAP=y
CONFIG_NVS=y
CONFIG_SETTINGS_NVS=y

CONFIG_SHELL_MINIMAL=y
CONFIG_HWINFO_SHELL=n
CONFIG_FLASH_SHELL=n
CONFIG_ADC_SHELL=n
CONFIG_ZMK_EXT_POWER=n

CONFIG_USB_SELF_POWERED=n

CONFIG_USE_DT_CODE_PARTITION=y
CONFIG_BUILD_OUTPUT_UF2=y
CONFIG_ZMK_BOOTMODE_MAGIC_VALUE_BOOTLOADER_TYPE_TINYUF2=y
CONFIG_RETAINED_MEM=y
CONFIG_RETENTION=y
CONFIG_RETENTION_BOOT_MODE=y
```

## boards/calvin/calvin_toprevan/Kconfig.calvin_toprevan
```kconfig
# Copyright (c) 2024 Pete Johanson
# SPDX-License-Identifier: Apache-2.0

config BOARD_CALVIN_TOPREVAN
	select SOC_STM32F401XC
	select ADC
	select ZMK_BOARD_COMPAT
	imply RETAINED_MEM
	imply RETENTION
	imply RETENTION_BOOT_MODE
```

## boards/calvin/calvin_toprevan/Kconfig.defconfig
```kconfig
# Copyright (c) 2025-2026 Pete Johanson
# SPDX-License-Identifier: Apache-2.0

if BOARD_CALVIN_TOPREVAN

config ZMK_KEYBOARD_NAME
        default "TopreVan"

config ZMK_KSCAN_EC_MATRIX_SETTINGS_DISCRETE
	default y

config SPI_STM32_INTERRUPT
	default y
	depends on SPI

config BUILD_OUTPUT_UF2_USE_FLASH_BASE
	default y

config BUILD_OUTPUT_UF2_USE_FLASH_OFFSET
	default y

endif # BOARD_CALVIN_TOPREVAN
```

## boards/calvin/calvin_toprevan/board.yml
```yaml
board:
  name: calvin_toprevan
  vendor: calvin
  socs:
    - name: stm32f401xc
      variants:
      - name: big_bar
      - name: eight_half_bar
```

## boards/calvin/calvin_toprevan/calvin_toprevan_defconfig
```kconfig
# Copyright (c) 2024 Pete Johanson
# SPDX-License-Identifier: MIT

# Enable GPIO
CONFIG_GPIO=y

# Clock configuration
CONFIG_CLOCK_CONTROL=y

# enable pin controller
CONFIG_PINCTRL=y

# ZMK Settings
CONFIG_ZMK_USB=y

# ADC Usage for EC
CONFIG_ADC=y

# Settings subsystem
CONFIG_SETTINGS=y
CONFIG_FLASH=y
CONFIG_FLASH_MAP=y
CONFIG_NVS=y
CONFIG_SETTINGS_NVS=y

CONFIG_SHELL_MINIMAL=y
CONFIG_HWINFO_SHELL=n
CONFIG_FLASH_SHELL=n
CONFIG_ADC_SHELL=n
CONFIG_ZMK_EXT_POWER=n

CONFIG_USB_SELF_POWERED=n

CONFIG_USE_DT_CODE_PARTITION=y
CONFIG_BUILD_OUTPUT_UF2=y
CONFIG_ZMK_BOOTMODE_MAGIC_VALUE_BOOTLOADER_TYPE_TINYUF2=y
```
