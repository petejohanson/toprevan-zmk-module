/*
 * Copyright (c) 2024 Pete Johanson
 *
 * SPDX-License-Identifier: MIT
 */

/dts-v1/;
#include <st/f4/stm32f401Xc.dtsi>
#include <st/f4/stm32f401c(b-c)ux-pinctrl.dtsi>

#include <zephyr/dt-bindings/dt-util.h>
#include <zephyr/dt-bindings/adc/adc.h>

#include <dt-bindings/zmk/matrix_transform.h>
#include <physical_layouts.dtsi>

#define EC_MATRIX(_name, _bottom_mask)                           \
	_name: _name {                                           \
	    compatible = "zmk,kscan-ec-matrix";                  \
	    status = "disabled";                                 \
	    pinctrl-0 = <&ec_pin1 &ec_pin2 &ec_pin3 &ec_pin4>;   \
	    pinctrl-names = "default";                           \
	    input-gpios                                          \
	        = <&left_mux 2 0>                                \
	        , <&left_mux 1 0>                                \
	        , <&left_mux 0 0>                                \
	        , <&left_mux 3 0>                                \
	        , <&left_mux 4 0>                                \
	        , <&right_mux 2 0>                               \
	        , <&right_mux 1 0>                               \
	        , <&right_mux 0 0>                               \
	        , <&right_mux 3 0>                               \
	        , <&right_mux 4 0>                               \
	        , <&right_mux 5 0>                               \
	        , <&right_mux 6 0>                               \
	    ;                                                    \
	    strobe-gpios                                         \
	        = <&gpiob 13 GPIO_ACTIVE_HIGH>                   \
	        , <&gpiob 14 GPIO_ACTIVE_HIGH>                   \
	        , <&gpiob 12 GPIO_ACTIVE_HIGH>                   \
	        , <&gpiob 15 GPIO_ACTIVE_HIGH>                   \
	        ;                                                \
	    io-channels = <&adc1 3>;                             \
	    matrix-relax-us = <0>;                               \
	    adc-read-settle-us = <0>;                            \
	    strobe-input-masks = <0 0 0 (_bottom_mask)>;         \
	    drain-gpios = <&gpioa 4 GPIO_OPEN_DRAIN>;            \
	    trigger-percentage = <60>;                           \
	    skip-startup-calibration;                            \
	};

#define EC_TRANSFORM(_name, _bottom_row) \
	_name: _name {                                                                                            \
		compatible = "zmk,matrix-transform";                                                              \
		status = "disabled";                                                                              \
		rows = <4>;                                                                                       \
		columns = <12>;                                                                                   \
		map = <                                                                                           \
		RC(0,0) RC(0,1) RC(0,2) RC(0,3) RC(0,4) RC(0,5) RC(0,6) RC(0,7) RC(0,8) RC(0,9) RC(0,10) RC(0,11) \
		RC(1,0) RC(1,1) RC(1,2) RC(1,3) RC(1,4) RC(1,5) RC(1,6) RC(1,7) RC(1,8) RC(1,9) RC(1,10) RC(1,11) \
		RC(2,0) RC(2,1) RC(2,2) RC(2,3) RC(2,4) RC(2,5) RC(2,6) RC(2,7) RC(2,8) RC(2,9) RC(2,10) RC(2,11) \
		_bottom_row                                                                                       \
		>;                                                                                                \
	};

#define PHYS_LAYOUT(_name, _display, _matrix, _transform, ...)                \
	_name: _name {                                               \
        	compatible = "zmk,physical-layout";                  \
		status = "disabled";                                 \
        	display-name = _display;                             \
        	transform = <&_transform>;                           \
		kscan = <&_matrix>;                                  \
        	keys                                                 \
        	    = <&key_physical_attrs 100 100 000  000 0 0 0>   \
        	    , <&key_physical_attrs 100 100 100  000 0 0 0>   \
        	    , <&key_physical_attrs 100 100 200  000 0 0 0>   \
        	    , <&key_physical_attrs 100 100 300  000 0 0 0>   \
        	    , <&key_physical_attrs 100 100 400  000 0 0 0>   \
        	    , <&key_physical_attrs 100 100 500  000 0 0 0>   \
        	    , <&key_physical_attrs 100 100 600  000 0 0 0>   \
        	    , <&key_physical_attrs 100 100 700  000 0 0 0>   \
        	    , <&key_physical_attrs 100 100 800  000 0 0 0>   \
        	    , <&key_physical_attrs 100 100 900  000 0 0 0>   \
        	    , <&key_physical_attrs 100 100 1000 000 0 0 0>   \
        	    , <&key_physical_attrs 175 100 1100 000 0 0 0>   \
                                                                     \
        	    , <&key_physical_attrs 125 100 000  100 0 0 0>   \
        	    , <&key_physical_attrs 100 100 125  100 0 0 0>   \
        	    , <&key_physical_attrs 100 100 225  100 0 0 0>   \
        	    , <&key_physical_attrs 100 100 325  100 0 0 0>   \
        	    , <&key_physical_attrs 100 100 425  100 0 0 0>   \
        	    , <&key_physical_attrs 100 100 525  100 0 0 0>   \
        	    , <&key_physical_attrs 100 100 625  100 0 0 0>   \
        	    , <&key_physical_attrs 100 100 725  100 0 0 0>   \
        	    , <&key_physical_attrs 100 100 825  100 0 0 0>   \
        	    , <&key_physical_attrs 100 100 925  100 0 0 0>   \
        	    , <&key_physical_attrs 100 100 1025 100 0 0 0>   \
        	    , <&key_physical_attrs 150 100 1125 100 0 0 0>   \
                                                                     \
        	    , <&key_physical_attrs 175 100 000  200 0 0 0>   \
        	    , <&key_physical_attrs 100 100 175  200 0 0 0>   \
        	    , <&key_physical_attrs 100 100 275  200 0 0 0>   \
        	    , <&key_physical_attrs 100 100 375  200 0 0 0>   \
        	    , <&key_physical_attrs 100 100 475  200 0 0 0>   \
        	    , <&key_physical_attrs 100 100 575  200 0 0 0>   \
        	    , <&key_physical_attrs 100 100 675  200 0 0 0>   \
        	    , <&key_physical_attrs 100 100 775  200 0 0 0>   \
        	    , <&key_physical_attrs 100 100 875  200 0 0 0>   \
        	    , <&key_physical_attrs 100 100 975  200 0 0 0>   \
        	    , <&key_physical_attrs 100 100 1075 200 0 0 0>   \
        	    , <&key_physical_attrs 100 100 1175 200 0 0 0>   \
                                                                     \
		     __VA_ARGS__                                         \
        	    ;                                                \
	};

/ {
	model = "Calvin TopreVan";
	compatible = "calvin,toprevan";

	chosen {
		zephyr,sram = &sram0;
		zephyr,flash = &flash0;
		zephyr,code-partition = &code_partition;
	};

	left_mux: left_mux {
		compatible = "zmk,gpio-mux";
	
	    select-gpios
	        = <&gpiob 5 GPIO_ACTIVE_HIGH>
	        , <&gpiob 4 GPIO_ACTIVE_HIGH>
	        , <&gpiob 3 GPIO_ACTIVE_HIGH>
	        ;
	
	    en-gpios = <&gpiob 0 GPIO_ACTIVE_LOW>;
	
	    gpio-controller;
	    ngpios = <8>;
	    #gpio-cells = <2>;
	};
	
	right_mux: right_mux {
		compatible = "zmk,gpio-mux";
	
	    select-gpios
	        = <&gpiob 5 GPIO_ACTIVE_HIGH>
	        , <&gpiob 4 GPIO_ACTIVE_HIGH>
	        , <&gpiob 3 GPIO_ACTIVE_HIGH>
	        ;
	
	    en-gpios = <&gpiob 1 GPIO_ACTIVE_LOW>;
	
	    gpio-controller;
	    ngpios = <8>;
	    #gpio-cells = <2>;
	};

	EC_MATRIX(matrix, BIT(3) + BIT(5) + BIT(7))
	EC_TRANSFORM(transform, RC(3,0) RC(3,1) RC(3,2)         RC(3,4)         RC(3,6)         RC(3,8) RC(3,9) RC(3,10) RC(3,11))
	PHYS_LAYOUT(physical_layout, "Arrows", matrix, transform, 
        	    , <&key_physical_attrs 125 100 000  300 0 0 0>
        	    , <&key_physical_attrs 100 100 125  300 0 0 0>
        	    , <&key_physical_attrs 125 100 225  300 0 0 0>
        	    , <&key_physical_attrs 275 100 350  300 0 0 0>
        	    , <&key_physical_attrs 225 100 625  300 0 0 0>
        	    , <&key_physical_attrs 125 100 850  300 0 0 0>
        	    , <&key_physical_attrs 100 100 975  300 0 0 0>
        	    , <&key_physical_attrs 100 100 1075 300 0 0 0>
        	    , <&key_physical_attrs 100 100 1175 300 0 0 0>
	)

	EC_MATRIX(big_bar_matrix, BIT(3) + BIT(4) + BIT(5) + BIT(7) + BIT(8))
	EC_TRANSFORM(big_bar_transform, RC(3,0) RC(3,1) RC(3,2)                         RC(3,6)                 RC(3,9) RC(3,10) RC(3,11))
	PHYS_LAYOUT(big_bar_physical_layout, "Big Bar", big_bar_matrix, big_bar_transform, 
        	    , <&key_physical_attrs 125 100 000  300 0 0 0>
        	    , <&key_physical_attrs 100 100 125  300 0 0 0>
        	    , <&key_physical_attrs 125 100 225  300 0 0 0>
        	    , <&key_physical_attrs 625 100 350  300 0 0 0>
        	    , <&key_physical_attrs 100 100 975  300 0 0 0>
        	    , <&key_physical_attrs 100 100 1075 300 0 0 0>
        	    , <&key_physical_attrs 100 100 1175 300 0 0 0>
	)
};

&gpioc { status = "disabled"; };
&gpiod { status = "disabled"; };
&gpioe { status = "disabled"; };
&gpiof { status = "disabled"; };
&gpiog { status = "disabled"; };
&gpioh { status = "disabled"; };

&flash0 {
	reg = <0x08000000 DT_SIZE_K(128)>;

	partitions {
		compatible = "fixed-partitions";
		#address-cells = <1>;
		#size-cells = <1>;

		boot_partition: partition@0 {
			label = "tinyuf2";
			reg = <0x00000000 DT_SIZE_K(32)>;
		};

		/*
		 * Use third and fourht 16K sectors for storage
		 */

		storage_partition: partition@8000 {
			label = "storage";
			reg = <0x00008000 DT_SIZE_K(32)>;
		};

		code_partition: partition@10000 {
			label = "code";
			reg = <0x00010000 DT_SIZE_K(64)>;
			read-only;
		};

	};
};

zephyr_udc0: &usbotg_fs {
	pinctrl-0 = <&usb_otg_fs_dm_pa11 &usb_otg_fs_dp_pa12>;
	pinctrl-names = "default";
	status = "okay";
};

&adc1 {
	pinctrl-0 = <&adc1_in3_pa3>;
	pinctrl-names = "default";
	st,adc-clock-source = <SYNC>;
	st,adc-prescaler = <2>;
	status = "okay";

	#address-cells = <1>;
	#size-cells = <0>;

	channel@3 {
		reg = <3>;
		zephyr,gain = "ADC_GAIN_1";
		zephyr,reference = "ADC_REF_INTERNAL";
		zephyr,acquisition-time = <ADC_ACQ_TIME_DEFAULT>;
		zephyr,resolution = <10>;
	};
};

&pinctrl {
    ec_pin1: ec_pin1 {
        pinmux = <STM32_PINMUX('B', 12, GPIO)>;

        slew-rate = "very-high-speed";
    };

    ec_pin2: ec_pin2 {
        pinmux = <STM32_PINMUX('B', 13, GPIO)>;

        slew-rate = "very-high-speed";
    };

    ec_pin3: ec_pin3 {
        pinmux = <STM32_PINMUX('B', 14, GPIO)>;

        slew-rate = "very-high-speed";
    };

    ec_pin4: ec_pin4 {
        pinmux = <STM32_PINMUX('B', 15, GPIO)>;

        slew-rate = "very-high-speed";
    };
};

&clk_lsi {
	status = "okay";
};

&clk_hse {
	clock-frequency = <DT_FREQ_M(8)>;
	status = "okay";
};

&pll {
	div-m = <8>;
	mul-n = <336>;
	div-p = <4>;
	div-q = <7>;
	clocks = <&clk_hse>;
	status = "okay";
};

&rcc {
	clocks = <&pll>;
	clock-frequency = <DT_FREQ_M(84)>;
	ahb-prescaler = <1>;
	apb1-prescaler = <2>;
	apb2-prescaler = <1>;
};

/ {
	magic_mapper {
		compatible = "zmk,bootmode-to-magic-mapper";
		status = "okay";

		#address-cells = <1>;
		#size-cells = <1>;

		boot_retention: retention@0 {
			compatible = "zephyr,retention";
			status = "okay";
			reg = <0x0 0x1>;
		};
	};

        sram@2000FFFC {
                compatible = "zephyr,memory-region", "mmio-sram";
                reg = <0x2000FFFC 0x4>;
                zephyr,memory-region = "RetainedMem";
                status = "okay";

                retainedmem {
                        compatible = "zephyr,retained-ram";
                        status = "okay";
                        #address-cells = <1>;
                        #size-cells = <1>;

                        magic_retention: retention@0 {
                                compatible = "zephyr,retention";
                                status = "okay";
                                reg = <0x0 0x4>;
                        };
                };
        };

        chosen {
                zephyr,boot-mode = &boot_retention;
		zmk,magic-boot-mode = &magic_retention;
        };
};

&sram0 {
        reg = <0x20000000 0xFFFC>;
};
