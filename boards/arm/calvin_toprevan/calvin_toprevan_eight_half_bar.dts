/*
 * Copyright (c) 2024 Pete Johanson
 *
 * SPDX-License-Identifier: MIT
 */

#include "calvin_toprevan.dtsi"

&eight_half_bar_matrix { status = "okay"; };
&eight_half_bar_transform { status = "okay"; };
&eight_half_bar_physical_layout { status = "okay"; };
