## boards/arm/calvin_toprevan/Kconfig.TopreVan
```kconfig
# Copyright (c) 2024 Pete Johanson
# SPDX-License-Identifier: MIT

config BOARD_CALVIN_TOPREVAN
	select SOC_STM32F401XC
	select ADC

config BOARD_CALVIN_TOPREVAN_BIG_BAR
	select SOC_STM32F401XC
	select ADC

config BOARD_CALVIN_TOPREVAN_EIGHT
	select SOC_STM32F401XC
	select ADC
```

## boards/arm/calvin_toprevan/Kconfig.calvin_toprevan
```kconfig
# Copyright (c) 2024 Pete Johanson
# SPDX-License-Identifier: MIT

config BOARD_CALVIN_TOPREVAN
	select SOC_STM32F401XC
	select ADC
```

## boards/arm/calvin_toprevan/Kconfig.calvin_toprevan_eight
```kconfig
# Copyright (c) 2024 Pete Johanson
# SPDX-License-Identifier: MIT

config BOARD_CALVIN_TOPREVAN_EIGHT
	select SOC_STM32F401XC
	select ADC
```

## boards/arm/calvin_toprevan/board.yml
```yaml
board:
  - name: calvin_toprevan
    vendor: calvin
    socs:
      - name: stm32f401xc
        variants:
          - name: zmk
  - name: calvin_toprevan_big_bar
    vendor: calvin
    socs:
      - name: stm32f401xc
        variants:
          - name: zmk
  - name: calvin_toprevan_eight
    vendor: calvin
    socs:
      - name: stm32f401xc
        variants:
          - name: zmk
```

## boards/calvin/toprevan/Kconfig.toprevan
```kconfig
# Copyright (c) 2024 Pete Johanson
# SPDX-License-Identifier: MIT

config BOARD_TOPREVAN
	select SOC_STM32F401XC
	select ADC
```
